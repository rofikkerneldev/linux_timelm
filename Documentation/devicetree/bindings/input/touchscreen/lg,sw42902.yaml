## Documentation/devicetree/bindings/input/touchscreen/lg,sw42902.yaml
```yaml
# SPDX-License-Identifier: GPL-2.0-only OR BSD-2-Clause
%YAML 1.2
---
$id: http://devicetree.org/schemas/input/touchscreen/lg,sw42902.yaml#
$schema: http://devicetree.org/meta-schemas/core.yaml#

title: Silicon Works SW42902 touchscreen

maintainers:
  - rofikkerneldev <rofikcoga@gmail.com>

description: |
  I2C touchscreen used in the LG V60 timelm JP DCM. The controller boots
  its existing flash firmware; the enable GPIOs switch its 3.3 V and
  1.8 V power rails.

allOf:
  - $ref: touchscreen.yaml#

properties:
  compatible:
    const: lg,sw42902

  reg:
    maxItems: 1

  interrupts:
    maxItems: 1

  reset-gpios:
    maxItems: 1
    description: Active-low controller reset

  vcl-gpios:
    maxItems: 1
    description: Active-high enable for the 3.3 V rail

  vdd-gpios:
    maxItems: 1
    description: Active-high enable for the 1.8 V rail

required:
  - compatible
  - reg
  - interrupts
  - reset-gpios
  - vcl-gpios
  - vdd-gpios
  - touchscreen-size-x
  - touchscreen-size-y

unevaluatedProperties: false

examples:
  - |
    #include <dt-bindings/gpio/gpio.h>
    #include <dt-bindings/interrupt-controller/irq.h>

    i2c {
        #address-cells = <1>;
        #size-cells = <0>;

        touchscreen@28 {
            compatible = "lg,sw42902";
            reg = <0x28>;
            interrupt-parent = <&tlmm>;
            interrupts = <39 IRQ_TYPE_LEVEL_LOW>;
            reset-gpios = <&tlmm 38 GPIO_ACTIVE_LOW>;
            vcl-gpios = <&tlmm 67 GPIO_ACTIVE_HIGH>;
            vdd-gpios = <&tlmm 68 GPIO_ACTIVE_HIGH>;
            touchscreen-size-x = <1080>;
            touchscreen-size-y = <2460>;
        };
    };
```
